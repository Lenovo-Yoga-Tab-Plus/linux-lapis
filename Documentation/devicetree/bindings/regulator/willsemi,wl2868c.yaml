## Documentation/devicetree/bindings/regulator/willsemi,wl2868c.yaml
```yaml
# SPDX-License-Identifier: (GPL-2.0-only OR BSD-2-Clause)
%YAML 1.2
---
$id: http://devicetree.org/schemas/regulator/willsemi,wl2868c.yaml#
$schema: http://devicetree.org/meta-schemas/core.yaml#

title: Will Semiconductor WL2868C camera power management IC

maintainers:
  - Qianhui Xu <xiaqinghuan@mail.ustc.edu.cn>

description:
  The WL2868C is a camera power management IC with seven programmable LDOs.
  LDO1 and LDO2 share the VIN12 input and cover 0.496 V to 1.512 V; LDO3 and
  LDO4 share VIN34, and LDO5 to LDO7 have one input each, covering 1.504 V to
  3.544 V. All outputs are programmable in 8 mV steps.

properties:
  compatible:
    const: willsemi,wl2868c

  reg:
    maxItems: 1

  reset-gpios:
    maxItems: 1
    description: Active-low RST_N input.

  vin12-supply:
    description: Input supply for LDO1 and LDO2.

  vin34-supply:
    description: Input supply for LDO3 and LDO4.

  vin5-supply:
    description: Input supply for LDO5.

  vin6-supply:
    description: Input supply for LDO6.

  vin7-supply:
    description: Input supply for LDO7.

  regulators:
    type: object
    additionalProperties: false

    patternProperties:
      "^ldo[1-7]$":
        type: object
        $ref: regulator.yaml#
        unevaluatedProperties: false

required:
  - compatible
  - reg
  - regulators

additionalProperties: false

examples:
  - |
    i2c {
        #address-cells = <1>;
        #size-cells = <0>;

        pmic@2f {
            compatible = "willsemi,wl2868c";
            reg = <0x2f>;

            regulators {
                ldo1 {
                    regulator-max-microvolt = <1128000>;
                    regulator-min-microvolt = <1128000>;
                };
            };
        };
    };
...
```
